## conf/layer.conf
```bitbake
# We have a conf and classes directory, add to BBPATH
BBPATH .= ":${LAYERDIR}"

# We have recipes-* directories, add to BBFILES
BBFILES += "${LAYERDIR}/recipes-*/*/*.bb \
            ${LAYERDIR}/recipes-*/*/*.bbappend"

BBFILE_COLLECTIONS += "meta-vfi"
BBFILE_PATTERN_meta-vfi = "^${LAYERDIR}/"
BBFILE_PRIORITY_meta-vfi = "6"

LAYERDEPENDS_meta-vfi = "core"
LAYERSERIES_COMPAT_meta-vfi = "zeus"

LICENSE_PATH += "${LAYERDIR}/custom-licenses"
```
